int ex[] = {0x81, 0x42, 0x24, 0x18, 0x18, 0x24, 0x42, 0x81};
int font_f[26][8] = {
#define times 500
0x0,0xFE,0x19,0x19,0x19,0x19,0xFE,0x0,//A
0x0,0xFF,0x99,0x99,0x99,0x99,0x66,0x0,//B
0x0,0x7E,0xFF,0x81,0x81,0x81,0x42,0x0,//C
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0x0,0xC3,0xE3,0xD3,0xCB,0xC7,0xC3,0x0 //Z 
};
int font_colunm[] = { 0x1,0x2,0x4,0x8,0x10,0x20,0x40,0x80 };
int heart[] = {0x1C,0x22,0x42,0x84,0x84,0x42,0x22,0x1C};
void setup() {
DDRA = 0xFF;//นอน
DDRC = 0xFF;//ตั้ง
PORTA =   0x0;
PORTC =   0xFF;
}
void draw_h(){
  int t = 0;
    while(t<3000){
    for(int i = 0; i<8;i++){
      PORTA = heart[i]; //row 7
      PORTC = ~font_colunm[i]; //col 8 
      delay(1);
      PORTA = 0x0;
      PORTC = 0xFF;
      t++;
     }
    }
}
void draw(int font[]){
  int t = 0;
    while(t<times){
    for(int i = 0; i<8;i++){
      PORTA = font[i]; //row 7
      PORTC = ~font_colunm[i]; //col 8 
      delay(1);
      PORTA = 0x0;
      PORTC = 0xFF;
      t++;
     }
    }
}
void loop() {
        for(int i = 0; i < 8; i++){
          for(int j = 0; j < 8; j++){
            PORTA = font_colunm[i];
            PORTC = ~font_colunm[j];
            delay(50);
            PORTA = 0x0;
            PORTC = 0xFF;
          }
        }
        int tt=0;
         while(tt<10){
            tt++;
            for(int i = 0; i < 8;i++){
            PORTA = ex[i]; //row 7
            PORTC = ~ex[i]; //col 8 
            delay(50);
            PORTA = 0x0;
            PORTC = 0xFF;
           } 
         }
          for(int i = 0; i < 26;i++){
            draw(font_f[i]);
          }
          draw_h();
}
